## conf/layer.conf
```bitbake
# We have a conf and classes directory, append to BBPATH
BBPATH =. "${LAYERDIR}:"

# We have a recipes directory, add to BBFILES
BBFILES += "${LAYERDIR}/recipes*/*/*.bb ${LAYERDIR}/recipes*/*/*.bbappend"

BBFILE_COLLECTIONS += "meta-smarct335x-sdk04010006"
BBFILE_PATTERN_meta-smarct335x-sdk04010006 := "^${LAYERDIR}/"
BBFILE_PRIORITY_meta-smarct335x-sdk04010006 = "20"

EMB_UBOOT_MIRROR ?= "git://git@github.com/eason-eec/smarc-t335x-uboot.git"
EMB_KERNEL_MIRROR ?= "git://git@github.com/eason-eec/smarc-ti-linux-kernel.git"

MIRRORS += " \
${EMB_UBOOT_MIRROR}   git://github.com/eason-eec/smarc-uboot.git;protocol=git;branch=${SRCBRANCH} \n \
${EMB_KERNEL_MIRROR}   git://github.com/eason-eec/linux-kernel.git;protocol=git;branch=${SRCBRANCH} \n \
"
```

## conf/machine/smarct335x.conf
```bitbake
#@TYPE: Machine
#@NAME: smarct335x
#@DESCRIPTION: Machine configuration for the Embedian's SMARC-T335X Computer on Modules

require conf/machine/include/ti33x.inc

# Name and version of the distribution
DISTRO_NAME = "smarct335x"
DISTRO_VERSION = "2017.06"
DISTRO_FEED_URI ?= "http://www.embedian.com"
FEEDURIPREFIX ?= "core-sdk/smarct335x/smarct3x-processor-sdk-04.01.00.06/deploy/ipk/"

# Specify kernel recipe
PREFERRED_PROVIDER_virtual/kernel_smarct335x = "linux-smarct335x-staging"
PREFERRED_VERSION_linux_smarct335x = "4.9"
KERNEL_DEVICETREE += "am335x-smarct335x.dtb"
CREATE_SRCIPK_pn-linux-smarct335x-staging = "1"
SRCIPK_INSTALL_DIR_pn-linux-smarct335x-staging = "board-support/linux-${PV}${KERNEL_LOCALVERSION}"

# Increase this everytime you change something in the kernel
MACHINE_KERNEL_PR = "r0"
KERNEL_IMAGETYPE = "zImage"

# Override several Arago distro package version selections.
PREFERRED_PROVIDER_virtual/bootloader_smarct335x = "u-boot-smarct335x"
PREFERRED_PROVIDER_u-boot_smarct335x = "u-boot-smarct335x"
PREFERRED_VERSION_u-boot_smarct335x = "2017.01-smarct335x"
UBOOT_MACHINE = "smarct335x_evm_uart3_defconfig"

# Use built-in LCD by default
XSERVER += "xf86-input-tslib"
MACHINE_GUI_CLASS = "smallscreen"
MACHINE_FEATURES += "touchscreen"

IMAGE_FSTYPES += "ubi tar.xz"

SERIAL_CONSOLE = ""
SERIAL_CONSOLES = "115200;ttyS3 115200;ttyO3"
SERIAL_CONSOLES_CHECK = "${SERIAL_CONSOLES}"

# UBI information.  Note that this is board and kernel specific.  Changes
# in your kernel port may require changes in these variables.  For more
# details about this board please see
# http://processors.wiki.ti.com/index.php/UBIFS_Support

# do ubiattach /dev/ubi_ctrl -m 11 -O 4096
# From dmesg:
# UBI: smallest flash I/O unit:    4096
# UBI: logical eraseblock size:    253952 bytes
# from ubiattach stdout:
# UBI device number 0, total 994 LEBs
MKUBIFS_ARGS = "-F -m 4096 -e 253952 -c 4000"

# do ubiattach /dev/ubi_ctrl -m 11 -O 4096
# from dmesg:
# UBI: smallest flash I/O unit:    4096
# UBI: physical eraseblock size:   262144 bytes (256 KiB)
# UBI: sub-page size:              4096
# UBI: VID header offset:          4096 (aligned 4096)
UBINIZE_ARGS = "-m 4096 -p 256KiB -s 4096 -O 4096"

# Ship all kernel modules by default
MACHINE_EXTRA_RRECOMMENDS = "kernel-modules"
# List common SoC features, may need to add touchscreen for specific machines
MACHINE_FEATURES += "touchscreen"
DISTRO_FEATURES_remove = "wayland"

MACHINE_FEATURES_remove="sgx"
PACKAGECONFIG_remove="wayland-egl"
```
